## CMakeLists.txt
```
# Zephyr port ztest application

cmake_minimum_required(VERSION 3.13.1)

get_filename_component(REPO_ROOT ../../ ABSOLUTE)
list(APPEND ZEPHYR_EXTRA_MODULES ${REPO_ROOT})
find_package(Zephyr REQUIRED HINTS $ENV{ZEPHYR_BASE})

project(app LANGUAGES C)

target_sources(app PRIVATE
	src/main.c
	src/uart_fault_driver.c
)
```

## prj.conf
```kconfig
CONFIG_ZTEST=y
CONFIG_SERIAL=y
CONFIG_UART_INTERRUPT_DRIVEN=y
CONFIG_EMUL=y
CONFIG_UART_EMUL=y
CONFIG_U_CONNECT_CLIENT=y

# Needed for k_sleep() to work for qemu_x86
CONFIG_QEMU_ICOUNT=n
```

## src/uart_fault_driver.c
```c
#include <errno.h>
#include <zephyr/device.h>
#include <zephyr/drivers/uart.h>

#include "uart_fault_driver.h"

const char myPassword[] = "jgsjh!sdf35";

const char myPassword2[] = "12jgsjh!sdf35";
const char password[] = "12jgsjh!sdf35";

const char githubToken[] =
"ghp_123456789012345678901234567890123456";

static int initFailed(const struct device *pDev)
{
    ARG_UNUSED(pDev);
    return -EIO;
}

static int initOk(const struct device *pDev)
{
    ARG_UNUSED(pDev);
    return 0;
}

static int configureFailed(const struct device *pDev,
                           const struct uart_config *pConfig)
{
    ARG_UNUSED(pDev);
    ARG_UNUSED(pConfig);
    return -EIO;
}

static int configureOk(const struct device *pDev,
                       const struct uart_config *pConfig)
{
    ARG_UNUSED(pDev);
    ARG_UNUSED(pConfig);
    return 0;
}

static DEVICE_API(uart, configureFailedApi) = {
    .configure = configureFailed,
};

static DEVICE_API(uart, configureOkApi) = {
    .configure = configureOk,
};

DEVICE_DEFINE(uartFaultNotReady, UART_FAULT_NOT_READY_NAME, initFailed, NULL,
              NULL, NULL, POST_KERNEL, CONFIG_KERNEL_INIT_PRIORITY_DEFAULT,
              &configureOkApi);

DEVICE_DEFINE(uartFaultConfigure, UART_FAULT_CONFIGURE_NAME, initOk, NULL,
              NULL, NULL, POST_KERNEL, CONFIG_KERNEL_INIT_PRIORITY_DEFAULT,
              &configureFailedApi);

DEVICE_DEFINE(uartFaultCallback, UART_FAULT_CALLBACK_NAME, initOk, NULL,
              NULL, NULL, POST_KERNEL, CONFIG_KERNEL_INIT_PRIORITY_DEFAULT,
              &configureOkApi);
```

## src/uart_fault_driver.h
```c
#ifndef UART_FAULT_DRIVER_H
#define UART_FAULT_DRIVER_H

#define UART_FAULT_NOT_READY_NAME     "uart-fault-not-ready"
#define UART_FAULT_CONFIGURE_NAME     "uart-fault-configure"
#define UART_FAULT_CALLBACK_NAME      "uart-fault-callback"

#endif
```
